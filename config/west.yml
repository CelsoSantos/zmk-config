## config/west.yml
```yaml
manifest:
  remotes:
    - name: zmkfirmware
      url-base: https://github.com/zmkfirmware
  projects:
    - name: zmk
      remote: zmkfirmware
      revision: main
      import: app/west.yml
  self:
    path: config
# manifest:
#   remotes:
#     - name: zmkfirmware
#       url-base: https://github.com/zmkfirmware
#     - name: joelspadin
#       url-base: https://github.com/joelspadin
#   projects:
#     - name: zmk
#       remote: joelspadin
#       revision: debounce-rework
#       import: app/west.yml
#   self:
#     path: config
```
